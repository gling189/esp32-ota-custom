## sdkconfig.defaults
```kconfig
# Default sdkconfig parameters to use the OTA
# partition table layout, with a 4MB flash size
CONFIG_ESPTOOLPY_FLASHSIZE_4MB=y
# CONFIG_PARTITION_TABLE_TWO_OTA=y
# 
CONFIG_PARTITION_TABLE_CUSTOM=y
CONFIG_PARTITION_TABLE_CUSTOM_FILENAME="partitions_ota_user.csv"
CONFIG_PARTITION_TABLE_FILENAME="partitions_ota_user.csv"


CONFIG_EXAMPLE_CONNECT_WIFI=y
CONFIG_EXAMPLE_WIFI_SSID="test"
CONFIG_EXAMPLE_WIFI_PASSWORD="test1234"

CONFIG_EXAMPLE_FIRMWARE_UPG_URL="http://192.168.28.206:8070/native_ota.bin"
```
